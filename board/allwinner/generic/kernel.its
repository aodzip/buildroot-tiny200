## board/allwinner/generic/kernel.its
```
/dts-v1/;

/ {
    description = "Generic Allwinner FIT Image";
    #address-cells = <1>;

    images {
        kernel@0 {
            description = "Linux kernel";
            data = /incbin/("zImage");
            type = "kernel";
            arch = "arm";
            os = "linux";
            compression = "none";
            load = <0x80000000>;
            entry = <0x80000000>;

            hash@0 {
                algo = "crc32";
            };
        };

        fdt@0 {
            description = "Flattened Device Tree blob";
            data = /incbin/("devicetree.dtb");
            type = "flat_dt";
            arch = "arm";
            compression = "none";

            hash@0 {
                algo = "crc32";
            };
        };
    };

    configurations {
        default = "conf@0";
        conf@0 {
            description = "Kernel, DeviceTree";
            kernel = "kernel@0";
            fdt = "fdt@0";

            hash@0 {
                algo = "crc32";
            };
        };
    };
};
```

## board/hatlab/badge200/hatlab_badge200_defconfig
```kconfig
BR2_arm=y
BR2_ARM_CPU_ARMV5=y

# Toolchain
BR2_TOOLCHAIN_BUILDROOT_GLIBC=y

# GCC Options
BR2_TOOLCHAIN_BUILDROOT_CXX=y
BR2_GCC_ENABLE_LTO=y

# GDB Options
BR2_PACKAGE_HOST_GDB=y
BR2_PACKAGE_HOST_GDB_PYTHON=y
BR2_PACKAGE_HOST_GDB_SIM=y
BR2_PACKAGE_HOST_GDB_TUI=y
BR2_PACKAGE_GDB=y
BR2_PACKAGE_GDB_SERVER=y

# Host Config
BR2_PACKAGE_HOST_PYTHON3=y
BR2_PACKAGE_HOST_PYTHON3_SSL=y
BR2_PACKAGE_HOST_UBOOT_TOOLS=y
BR2_PACKAGE_HOST_UBOOT_TOOLS_FIT_SUPPORT=y
BR2_PACKAGE_HOST_UBOOT_TOOLS_FIT_SIGNATURE_SUPPORT=y

# Bootloader
BR2_TARGET_UBOOT=y
BR2_TARGET_UBOOT_BUILD_SYSTEM_KCONFIG=y
BR2_TARGET_UBOOT_CUSTOM_VERSION=y
BR2_TARGET_UBOOT_CUSTOM_VERSION_VALUE="2020.07"
BR2_TARGET_UBOOT_USE_CUSTOM_CONFIG=y
BR2_TARGET_UBOOT_CUSTOM_CONFIG_FILE="board/hatlab/badge200/uboot.defconfig"
BR2_TARGET_UBOOT_NEEDS_DTC=y
BR2_TARGET_UBOOT_FORMAT_BIN=y
BR2_TARGET_UBOOT_SPL=y
BR2_TARGET_UBOOT_SPL_NAME="u-boot-sunxi-with-spl.bin"
BR2_TARGET_UBOOT_PATCH="board/allwinner/suniv-f1c100s/patch/u-boot"
BR2_TARGET_UBOOT_CUSTOM_DTS_PATH="board/allwinner/suniv-f1c100s/devicetree/uboot/suniv-f1c100s.dtsi board/hatlab/badge200/devicetree/uboot/suniv-f1c100s-generic.dts"

# Kernel
BR2_LINUX_KERNEL=y
BR2_PACKAGE_HOST_LINUX_HEADERS_CUSTOM_5_4=y
BR2_LINUX_KERNEL_CUSTOM_VERSION=y
BR2_LINUX_KERNEL_CUSTOM_VERSION_VALUE="5.4.100"
BR2_LINUX_KERNEL_USE_CUSTOM_CONFIG=y
BR2_LINUX_KERNEL_CUSTOM_CONFIG_FILE="board/hatlab/badge200/linux.defconfig"
BR2_LINUX_KERNEL_DTS_SUPPORT=y
BR2_LINUX_KERNEL_PATCH="board/allwinner/suniv-f1c100s/patch/linux"
BR2_LINUX_KERNEL_CUSTOM_DTS_PATH="board/allwinner/suniv-f1c100s/devicetree/linux/suniv-f1c100s.dtsi board/hatlab/badge200/devicetree/linux/devicetree.dts"

# Filesystem
BR2_TARGET_ROOTFS_EXT2=y
BR2_TARGET_ROOTFS_EXT2_4=y
BR2_TARGET_ROOTFS_EXT2_SIZE="128M"
BR2_TARGET_ROOTFS_JFFS2=y
BR2_TARGET_ROOTFS_JFFS2_NANDFLASH_128K=y
BR2_TARGET_ROOTFS_SQUASHFS=y
BR2_PACKAGE_HOST_DOSFSTOOLS=y
BR2_PACKAGE_HOST_GENIMAGE=y
BR2_PACKAGE_HOST_MTOOLS=y
BR2_ROOTFS_OVERLAY="board/allwinner/generic/rootfs board/allwinner/suniv-f1c100s/rootfs board/hatlab/badge200/rootfs"
BR2_ROOTFS_POST_IMAGE_SCRIPT="board/hatlab/badge200/scripts/genimage.sh"
BR2_ROOTFS_POST_SCRIPT_ARGS="${BR2_TARGET_UBOOT_SPL_NAME}"

# Target Config
BR2_TARGET_GENERIC_ISSUE="Welcome to DAS-Security Hatlab BADGE200"
BR2_TARGET_GENERIC_HOSTNAME="badge200"
BR2_TARGET_GENERIC_ROOT_PASSWD="5227254bd12594b0"

# Target Package
BR2_PACKAGE_HAVEGED=y
BR2_PACKAGE_TSLIB=y
BR2_PACKAGE_FB_TEST_APP=y
BR2_PACKAGE_TINYALSA=y
BR2_PACKAGE_LIBV4L=y
BR2_PACKAGE_LIBV4L_UTILS=y
BR2_PACKAGE_FSWEBCAM=y
BR2_PACKAGE_EVTEST=y

BR2_PACKAGE_TREE=y
BR2_PACKAGE_LIBCURL=y
BR2_PACKAGE_LIBCURL_CURL=y
BR2_PACKAGE_LIBCURL_VERBOSE=y

BR2_PACKAGE_DNSMASQ=y
BR2_PACKAGE_DROPBEAR=y
BR2_PACKAGE_DROPBEAR_DISABLE_REVERSEDNS=y
BR2_PACKAGE_XINETD=y
BR2_PACKAGE_BLUEZ_TOOLS=y
BR2_PACKAGE_BLUEZ5_UTILS=y
BR2_PACKAGE_BLUEZ5_UTILS_OBEX=y
BR2_PACKAGE_BLUEZ5_UTILS_CLIENT=y
BR2_PACKAGE_BLUEZ5_UTILS_DEPRECATED=y
BR2_PACKAGE_BLUEZ5_UTILS_EXPERIMENTAL=y
BR2_PACKAGE_BLUEZ5_UTILS_PLUGINS_HEALTH=y
BR2_PACKAGE_BLUEZ5_UTILS_PLUGINS_MIDI=y
BR2_PACKAGE_BLUEZ5_UTILS_PLUGINS_NFC=y
BR2_PACKAGE_BLUEZ5_UTILS_PLUGINS_SAP=y
BR2_PACKAGE_BLUEZ5_UTILS_PLUGINS_SIXAXIS=y
BR2_PACKAGE_BLUEZ5_UTILS_TEST=y

BR2_PACKAGE_DBUS=y
BR2_PACKAGE_DBUS_GLIB=y

BR2_PACKAGE_UTIL_LINUX_UUIDD=y
BR2_PACKAGE_CAIRO=y
BR2_PACKAGE_GOBJECT_INTROSPECTION=y

BR2_PACKAGE_PYTHON3=y
BR2_PACKAGE_PYTHON3_PY_PYC=y
BR2_PACKAGE_DBUS_PYTHON=y

BR2_PACKAGE_PYTHON3_BZIP2=y
BR2_PACKAGE_PYTHON3_CODECSCJK=y
BR2_PACKAGE_PYTHON3_CURSES=y
BR2_PACKAGE_PYTHON3_DECIMAL=y
BR2_PACKAGE_PYTHON3_OSSAUDIODEV=y
BR2_PACKAGE_PYTHON3_READLINE=y
BR2_PACKAGE_PYTHON3_SSL=y
BR2_PACKAGE_PYTHON3_UNICODEDATA=y
BR2_PACKAGE_PYTHON3_SQLITE=y
BR2_PACKAGE_PYTHON3_PYEXPAT=y
BR2_PACKAGE_PYTHON3_XZ=y
BR2_PACKAGE_PYTHON3_ZLIB=y

BR2_PACKAGE_PYTHON_PYBLUEZ=y
BR2_PACKAGE_PYTHON_PYCRYPTODOME=y
BR2_PACKAGE_PYTHON_SCAPY=y
BR2_PACKAGE_PYTHON_PYCAIRO=y
```

## board/widora/mangopi/r3/widora_mangopi_r3_defconfig
```kconfig
BR2_arm=y
BR2_ARM_CPU_ARMV5=y

# Toolchain
BR2_TOOLCHAIN_BUILDROOT_GLIBC=y

# GCC Options
BR2_TOOLCHAIN_BUILDROOT_CXX=y
BR2_GCC_ENABLE_LTO=y

# GDB Options
BR2_PACKAGE_HOST_GDB=y
BR2_PACKAGE_HOST_GDB_PYTHON=y
BR2_PACKAGE_HOST_GDB_SIM=y
BR2_PACKAGE_HOST_GDB_TUI=y
BR2_PACKAGE_GDB=y
BR2_PACKAGE_GDB_SERVER=y

# Host Config
BR2_PACKAGE_HOST_PYTHON3=y
BR2_PACKAGE_HOST_PYTHON3_SSL=y
BR2_PACKAGE_HOST_UBOOT_TOOLS=y
BR2_PACKAGE_HOST_UBOOT_TOOLS_FIT_SUPPORT=y
BR2_PACKAGE_HOST_UBOOT_TOOLS_FIT_SIGNATURE_SUPPORT=y

# Bootloader
BR2_TARGET_UBOOT=y
BR2_TARGET_UBOOT_BUILD_SYSTEM_KCONFIG=y
BR2_TARGET_UBOOT_CUSTOM_VERSION=y
BR2_TARGET_UBOOT_CUSTOM_VERSION_VALUE="2020.07"
BR2_TARGET_UBOOT_NEEDS_DTC=y
BR2_TARGET_UBOOT_FORMAT_BIN=y
BR2_TARGET_UBOOT_SPL=y
BR2_TARGET_UBOOT_USE_CUSTOM_CONFIG=y
BR2_TARGET_UBOOT_SPL_NAME="u-boot-sunxi-with-spl.bin"
BR2_TARGET_UBOOT_PATCH="board/allwinner/suniv-f1c100s/patch/u-boot"

BR2_TARGET_UBOOT_CUSTOM_CONFIG_FILE="board/widora/mangopi/r3/uboot.defconfig"
BR2_TARGET_UBOOT_CUSTOM_DTS_PATH="board/allwinner/suniv-f1c100s/devicetree/uboot/suniv-f1c100s.dtsi board/widora/mangopi/r3/devicetree/uboot/suniv-f1c100s-generic.dts"

# Kernel
BR2_LINUX_KERNEL=y
BR2_PACKAGE_HOST_LINUX_HEADERS_CUSTOM_5_4=y
BR2_LINUX_KERNEL_CUSTOM_VERSION=y
BR2_LINUX_KERNEL_CUSTOM_VERSION_VALUE="5.4.99"
BR2_LINUX_KERNEL_DTS_SUPPORT=y
BR2_LINUX_KERNEL_USE_CUSTOM_CONFIG=y
BR2_LINUX_KERNEL_PATCH="board/allwinner/suniv-f1c100s/patch/linux"

BR2_LINUX_KERNEL_CUSTOM_CONFIG_FILE="board/allwinner/suniv-f1c100s/linux.defconfig"
BR2_LINUX_KERNEL_CUSTOM_DTS_PATH="board/allwinner/suniv-f1c100s/devicetree/linux/suniv-f1c100s.dtsi board/widora/mangopi/r3/devicetree/linux/devicetree.dts"

# Filesystem
BR2_TARGET_ROOTFS_CPIO=y
BR2_TARGET_ROOTFS_CPIO_GZIP=y
BR2_TARGET_ROOTFS_EXT2=y
BR2_TARGET_ROOTFS_EXT2_4=y
BR2_TARGET_ROOTFS_EXT2_SIZE="100M"
BR2_TARGET_ROOTFS_SQUASHFS=y
BR2_TARGET_ROOTFS_SQUASHFS4_GZIP=y
BR2_PACKAGE_HOST_DOSFSTOOLS=y
BR2_PACKAGE_HOST_GENIMAGE=y
BR2_PACKAGE_HOST_MTOOLS=y
BR2_ROOTFS_POST_IMAGE_SCRIPT="board/allwinner/generic/scripts/genimage.sh"
BR2_ROOTFS_POST_SCRIPT_ARGS="${BR2_TARGET_UBOOT_SPL_NAME}"

BR2_ROOTFS_OVERLAY="board/allwinner/generic/rootfs board/allwinner/suniv-f1c100s/rootfs board/widora/mangopi/r3/rootfs"

# Target Config
BR2_PACKAGE_UTIL_LINUX_UUIDD=y
BR2_ROOTFS_DEVICE_CREATION_DYNAMIC_EUDEV=y
BR2_PACKAGE_LIBCEDARC_ARCHLIB="toolchain-sunxi-arm9-glibc"

BR2_TARGET_GENERIC_ISSUE="Welcome to Widora MangoPi R3"
BR2_TARGET_GENERIC_HOSTNAME="mangopi-r3"

# Target Package
BR2_PACKAGE_HAVEGED=y
BR2_PACKAGE_UMTPRD=y
BR2_PACKAGE_TSLIB=y
BR2_PACKAGE_FB_TEST_APP=y
BR2_PACKAGE_TINYALSA=y
BR2_PACKAGE_LIBV4L=y
BR2_PACKAGE_LIBV4L_UTILS=y
BR2_PACKAGE_FSWEBCAM=y
```

## package/libcedarc/Config.in
```kconfig
menuconfig BR2_PACKAGE_LIBCEDARC
	bool "libcedarc"
	help
		Allwinner Cedar Video Engine Library

if BR2_PACKAGE_LIBCEDARC

config BR2_PACKAGE_LIBCEDARC_ARCHLIB
	string "Arch library select"
	default "arm-linux-gnueabihf"
	help
		akk44_32
		anou70_32
		alp50_32
		alp50_64
		amm60_32
		amm60_64
		aore80_32
		arm-none-linux-gnueabi
		arm-linux-gnueabi
		arm-linux-gnueabihf
		toolchain-sunxi-arm-glibc
		toolchain-sunxi-arm-musl
		toolchain-sunxi-aarch64-glibc
		toolchain-sunxi-aarch64-musl
		toolchain-sunxi-arm9-glibc
		toolchain-sunxi-arm9-musl

config BR2_PACKAGE_LIBCEDARC_ENCODER
	bool "Encoder support"
	default y
	help
		Enable MJPEG / H.264 / H.265 encoder

menuconfig BR2_PACKAGE_LIBCEDARC_DECODER
	bool "Decoder support"
	help
		Allwinner Cedar Video Engine Decoder library

if BR2_PACKAGE_LIBCEDARC_DECODER

config BR2_PACKAGE_LIBCEDARC_DECODER_AVS
	bool "AVS support"
	default y
	help
		Enable AVS decoder

config BR2_PACKAGE_LIBCEDARC_DECODER_H264
	bool "H.264 support"
	default y
	help
		Enable H.264 decoder

config BR2_PACKAGE_LIBCEDARC_DECODER_H265
	bool "H.265 support"
	default y
	help
		Enable H.265 decoder

config BR2_PACKAGE_LIBCEDARC_DECODER_MJPEG
	bool "MJPEG support"
	default y
	help
		Enable MJPEG decoder

config BR2_PACKAGE_LIBCEDARC_DECODER_MPEG2
	bool "MPEG2 support"
	default y
	help
		Enable MPEG2 decoder

config BR2_PACKAGE_LIBCEDARC_DECODER_MPEG4
	bool "MPEG4 support"
	default y
	help
		Enable MPEG4 decoder

config BR2_PACKAGE_LIBCEDARC_DECODER_VP8
	bool "VP8 support"
	default y
	help
		Enable VP8 decoder

config BR2_PACKAGE_LIBCEDARC_DECODER_VP9
	bool "VP9 support"
	default y
	help
		Enable VP9 decoder

config BR2_PACKAGE_LIBCEDARC_DECODER_WMV3
	bool "WMV3 support"
	default y
	help
		Enable WMV3 decoder

endif

comment "OpenMax required both encoder & decoder support"

config BR2_PACKAGE_LIBCEDARC_OPENMAX
	bool "OpenMax framework support"
	depends on BR2_PACKAGE_LIBCEDARC_DECODER && BR2_PACKAGE_LIBCEDARC_ENCODER
	help
		Enable OpenMax framework

endif
```
